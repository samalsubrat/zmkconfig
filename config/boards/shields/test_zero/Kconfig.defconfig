## config/boards/shields/test_zero/Kconfig.defconfig
```kconfig
# Copyright (c) 2022 Gleb Sabirzyanov
# SPDX-License-Identifier: MIT

if SHIELD_TEST_ZERO

config ZMK_KEYBOARD_NAME
	default "Test Zero"


config ZMK_DISPLAY
    def_bool y

config SSD1306
    def_bool y

config I2C
	default y

endif
```

## config/west.yml
```yaml
manifest:
  remotes:
    - name: zmkfirmware
      url-base: https://github.com/zmkfirmware
  projects:
    - name: zmk
      remote: zmkfirmware
      revision: rp2040-zero
      import: app/west.yml
  self:
    path: config
```
